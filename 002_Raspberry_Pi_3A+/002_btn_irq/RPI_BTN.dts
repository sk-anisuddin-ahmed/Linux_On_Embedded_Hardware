/dts-v1/;
/plugin/;

#include "dt-bindings/gpio/gpio.h"
#include "dt-bindings/interrupt-controller/irq.h"

/ {
    compatible = "brcm,bcm2835", "brcm,bcm2836", "brcm,bcm2837";

    fragment@0 {
        target-path = "/";
        __overlay__ {
            btn_led {
                compatible = "rpi,btn-led";
                status = "okay";

                interrupts = <24 IRQ_TYPE_EDGE_FALLING>;
                interrupt-parent = <&gpio>;

                led-gpios = <&gpio 17 GPIO_ACTIVE_HIGH>;
                btn-gpios = <&gpio 24 GPIO_ACTIVE_LOW>;
            };
        };
    };
};
