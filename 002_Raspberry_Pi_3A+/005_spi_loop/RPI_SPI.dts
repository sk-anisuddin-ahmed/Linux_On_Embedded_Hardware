/dts-v1/;
/plugin/;

/ {
    compatible = "brcm,bcm2835", "brcm,bcm2836", "brcm,bcm2837";

    fragment@0 {
        target = <&spi0>;
        __overlay__ {
            #address-cells = <1>;
            #size-cells = <0>;
            status = "okay";

            spi_loopback@0 {
                compatible = "rpi,spi-loopback";
                reg = <0>;  /* CE0 */
                spi-max-frequency = <1000000>;
                status = "okay";
            };
        };
    };
};
