/dts-v1/;
/plugin/;

/ {
    compatible = "brcm,bcm2835", "brcm,bcm2836", "brcm,bcm2837";

    fragment@0 {
        target = <&i2c1>;
        __overlay__ {
            #address-cells = <1>;
            #size-cells = <0>;
            status = "okay";

            ds1307@68 {
                compatible = "rpi,ds1307";
                reg = <0x68>;
                status = "okay";
            };
        };
    };
};
