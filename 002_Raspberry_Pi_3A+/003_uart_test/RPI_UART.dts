/dts-v1/;
/plugin/;

/ {
    compatible = "brcm,bcm2835", "brcm,bcm2836", "brcm,bcm2837";

    fragment@0 {
        target-path = "/";
        __overlay__ {
            uart_test {
                compatible = "rpi,uart-test";
                status = "okay";
            };
        };
    };
};
